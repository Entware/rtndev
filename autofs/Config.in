## autofs/Config.in
```kconfig
# autofs avanced configuration

menu "Configuration"
	depends on PACKAGE_autofs

config AUTOFS_OPENLDAP
	bool "enable OpenLDAP map support"
	default n

config AUTOFS_SASL
	bool "enable SASL support for LDAP maps"
	depends on AUTOFS_OPENLDAP
	default n

config AUTOFS_TIRPC
	bool "enable libtirpc support"
	default n

endmenu
```

## kronosnet/Config.in
```kconfig
if PACKAGE_libknet

comment "Build Options"

config KRONOSNET_INSTALL_TESTS
	bool "Install tests"
	help
		Provides all the libknet and libnozzle test suite.

comment	"Compress modules support"

config KRONOSNET_COMPRESS_BZIP2
	bool "Enable libknet bzip2 support"
	default y
	help
		Provides bzip2 compression support for libknet.

config KRONOSNET_COMPRESS_LZ4
	bool "Enable libknet lz4 support"
	default y
	help
		Provides lz4 and lz4hc compression support for libknet.

config KRONOSNET_COMPRESS_LZMA
	bool "Enable libknet lzma support"
	default y
	help
		Provides lzma compression support for libknet.

config KRONOSNET_COMPRESS_LZO2
	bool "Enable libknet lzo2 support"
	default y
	help
		Provides lzo2 compression support for libknet.

config KRONOSNET_COMPRESS_ZLIB
	bool "Enable libknet zlib support"
	default y
	help
		Provides zlib compression support for libknet.

config KRONOSNET_COMPRESS_ZSTD
	bool "Enable libknet zstd support"
	default y
	help
		Provides zstd compression support for libknet.

comment "Crypto modules support"

config KRONOSNET_CRIPTO_NSS
	bool "Enable libknet nss support"
	default y
	help
		Provides NSS crypto support for libknet.

config KRONOSNET_CRIPTO_OPENSSL
	bool "Enable libknet openssl support"
	default y
	help
		Provides OpenSSL crypto support for libknet.

endif
```
